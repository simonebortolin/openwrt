// SPDX-License-Identifier: GPL-2.0-or-later
// Copyright (C) 2026 Simone Bortolin
/* The F6005's OMCI panel, a node of the root: its board tree and its virtual unit include it where it sits, so both declare one panel. */
	/*
	 * The UNI panel this board presents over OMCI, MEASURED from its own
	 * stock firmware at O5 (MIB dump, 2026-11-28).
	 *
	 * ONE Ethernet UNI, ONE UNI-G, no VEIP, no POTS.  Management
	 * capability 2 (non-OMCI) on the single UNI-G.
	 */
	omci-uni {
		ethernet-uni-instances = /bits/ 16 <0x0101>;
		ethernet-uni-ports = /bits/ 8 <1>;
		ethernet-uni-types = /bits/ 8 <47>;
		uni-g-instances = /bits/ 16 <0x0101>;
		uni-g-management-capability = /bits/ 8 <2>;
		circuit-packs = /bits/ 16 <
			0x0101  47 1  8  0  0
			0x0180 248 1 64  8  8>;
		ip-host-instances = /bits/ 16 <0x0000>;
		ip-host-wan-mac = /bits/ 8 <1>;
		onu-capacity = /bits/ 16 <8 64 8 33>;
		downstream-queue-ports = /bits/ 16 <0x0101>;
	};
